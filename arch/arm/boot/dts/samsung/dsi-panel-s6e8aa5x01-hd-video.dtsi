/* Copyright (c) 2013-2014, The Linux Foundation. All rights reserved.
 *
 * This program is free software; you can redistribute it and/or modify
 * it under the terms of the GNU General Public License version 2 and
 * only version 2 as published by the Free Software Foundation.
 *
 * This program is distributed in the hope that it will be useful,
 * but WITHOUT ANY WARRANTY; without even the implied warranty of
 * MERCHANTABILITY or FITNESS FOR A PARTICULAR PURPOSE.  See the
 * GNU General Public License for more details.
 */

/*---------------------------------------------------------------------------
 * This file is autogenerated file using gcdb parser. Please do not edit it.
 * Update input XML file to add a new entry or update variable in this file
 * VERSION = "1.0"
 *---------------------------------------------------------------------------

 */
&mdss_mdp {
	dsi_s6e8aa5x01_hd_video: qcom,mdss_dsi_s6e8aa5x01_hd_video {
		qcom,mdss-dsi-panel-name = "ss_dsi_panel_S6E88A0_AMS427AP24_QHD";
		qcom,mdss-dsi-panel-controller = <&mdss_dsi0>;
		qcom,mdss-dsi-panel-type = "dsi_video_mode";
		qcom,mdss-dsi-panel-destination = "display_1";
		qcom,cont-splash-enabled;
		qcom,mdss-dsi-panel-framerate = <60>;
		qcom,mdss-dsi-virtual-channel-id = <0>;
		qcom,mdss-dsi-stream = <0>;
		qcom,mdss-dsi-panel-width = <540>;
		qcom,mdss-dsi-panel-height = <960>;
		qcom,mdss-pan-physical-width-dimension = <62>; /* <Width> real size of panel in mm */
		qcom,mdss-pan-physical-height-dimension = <110>; /*<Height> real size of panel in mm */
		qcom,mdss-dsi-lp11-init;
		qcom,mdss-dsi-lp11-reset;
		qcom,mdss-dsi-init-delay-us = <2000>;
		qcom,mdss-dsi-h-front-porch = <204>;
		qcom,mdss-dsi-h-back-porch = <100>;
		qcom,mdss-dsi-h-pulse-width = <20>;
		qcom,mdss-dsi-h-sync-skew = <0>;
		qcom,mdss-dsi-v-back-porch = <8>;
		qcom,mdss-dsi-v-front-porch = <14>;
		qcom,mdss-dsi-v-pulse-width = <2>;
		qcom,mdss-dsi-h-left-border = <0>;
		qcom,mdss-dsi-h-right-border = <0>;
		qcom,mdss-dsi-v-top-border = <0>;
		qcom,mdss-dsi-v-bottom-border = <0>;
		qcom,mdss-dsi-bpp = <24>;
		qcom,mdss-dsi-color-order = "rgb_swap_rgb";
		qcom,mdss-dsi-underflow-color = <0xFF>;
		qcom,mdss-dsi-border-color = <0>;
		qcom,mdss-dsi-dma-trigger = "trigger_sw";
		qcom,mdss-dsi-mdp-trigger = "none";
		qcom,mdss-dsi-bl-min-level = <1>;
		qcom,mdss-dsi-bl-max-level = <255>;
		qcom,mdss-dsi-lane-0-state;
		qcom,mdss-dsi-lane-1-state;
		qcom,mdss-dsi-lane-2-state;
		qcom,mdss-dsi-lane-3-state;
		qcom,mdss-dsi-bllp-eof-power-mode;
		qcom,mdss-dsi-bllp-power-mode;
		qcom,mdss-dsi-traffic-mode = "burst_mode";
		qcom,mdss-force-clk-lane-hs = <1>;
		qcom,mdss-dsi-reset-sequence = <1 5>, <0 1>, <1 10>;
		qcom,mdss-dsi-h-sync-pulse = <0>;
		qcom,mdss-dsi-hfp-power-mode;
		qcom,mdss-dsi-panel-timings = [87 1C 12 00 42 44 18 20 17 03 04 00];
		qcom,mdss-dsi-t-clk-post = <0x04>;
		qcom,mdss-dsi-t-clk-pre = <0x27>;
		qcom,mdss-dsi-pixel-packing = "loose";
		qcom,mdss-dsi-lane-map = "lane_map_0123";
		qcom,mdss-dsi-on-command-state = "dsi_lp_mode";
		qcom,mdss-dsi-off-command-state = "dsi_hs_mode";
		qcom,mdss-dsi-rx-eot-ignore;
		qcom,mdss-dsi-tx-eot-append;
				qcom,mdss-dsi-on-command = [
			39 00 00 00 00 00 03 F0 5a 5a /* Tesk key ON */
			39 00 00 00 00 00 03 FC 5a 5a /* Tesk key ON */
			/* 5. SRC_LATCH Set*/
			39 00 00 00 00 00 02 B0 11
			39 00 00 00 00 00 02 FD 11
			39 00 00 00 00 00 02 B0 13
			39 00 00 00 00 00 02 FD 18
			/* 7. AVDD Set*/
			39 00 00 00 00 00 02 B0 02
			39 00 00 00 00 00 02 B8 30
			/* Sleep out  wait 20ms */
			05 01 00 00 14 00 02 11 00

			/* PCD */
			39 00 00 00 00 00 02 CC 4C

			/* 1. Brightness condition set */
			39 00 00 00 00 00 22 /* Brightness gamma */
				ca 01 00 01 00 01 00 80
				80 80 80 80 80 80 80 80
				80 80 80 80 80 80 80 80
				80 80 80 80 80 80 80 00
				00 00

			39 00 00 00 00 00 06 B2 40 08 20 00 08 /* AID set */
			/* 2. ELVSS Condition set */
			39 00 00 00 00 00 03 B6 28 0B /* ELVSS */
			39 00 00 00 00 00 02 F7 03 /* Gamma/AID update */



			/* 3. ETC Condition set */
			39 00 00 00 00 00 02 55 00 /* ACL set */
			39 00 00 00 00 00 02 B0 03
			39 00 00 00 00 00 02 F4 02 /* AVC On */
			39 00 00 00 00 00 03 F2 04 0C
			39 00 00 00 00 00 03 F0 A5 A5
			39 00 00 00 20 00 03 FC A5 A5
			05 01 00 00 00 00 02 29 00 /* Display on */
		];

		qcom,mdss-dsi-off-command = [05 01 00 00 00 00 02 28 00
				 05 01 00 00 78 00 02 10 00];

		samsung,test_key_enable_tx_cmds = [
			39 00 00 00 00 00 03 F0 5A 5A
			39 01 00 00 00 00 03 fc 5a 5a
		];
		samsung,test_key_disable_tx_cmds = [
			39 00 00 00 00 00 03 F0 A5 A5
			39 01 00 00 00 00 03 fc A5 A5
		];
		samsung,chip_id_rx_cmds = [ 06 01 00 00 00 00 01 da 01 00
					    06 01 00 00 00 00 01 db 01 00
					    06 01 00 00 00 00 01 dc 01 00 ];
		samsung,gamma_tx_cmds = [
			39 01 00 00 00 00 22  /* Brightness Condition Set - Gamma 2.2 Setting*/
			CA 01 00 01 00 01 00
			80 80 80 80 80 80 80
			80 80 80 80 80 80 80
			80 80 80 80 80 80 80
			80 80 80 00 00 00
			39 01 00 00 00 00 02 F7 03  /* gamma upate */
		];
		samsung,g_param_tx_cmds = [ 15 01 00 00 00 00 02 B0 00 ];
		samsung,hbm_rx_cmds = [ 06 01 00 00 00 00 01 C8];

		samsung,hbm_gamma_tx_cmds = [
			39 00 00 00 00 00 22
				CA 01 00 01 00 01 00 80
				80 80 80 80 80 80 80 80
				80 80 80 80 80 80 80 80
				80 80 80 80 80 80 80 00
				00 00 ];

		samsung,hbm_tx_cmds = [
			39 00 00 00 00 00 02 B0 10
			39 00 00 00 00 00 02 B6 00
			39 00 00 00 00 00 02 F7 03	/* Gamma, LTPS(AID) update */
			39 00 00 00 00 00 02 55 02	/* power saving Set */
		];
		samsung,hbm_off_cmds = [
			39 00 00 00 00 00 02 B0 10
			39 00 00 00 00 00 02 B6 00
			39 01 00 00 00 00 02 F7 03	
		];
		samsung,aid_tx_cmds = [
			39 00 00 00 00 00 06 B2 40 08 20 03 77	/* 00 AOR 90.9% */
			39 00 00 00 00 00 06 B2 40 08 20 03 73	/* 01 AOR 90.5% */
			39 00 00 00 00 00 06 B2 40 08 20 03 69	/* 02 AOR 89.4% 181*/
			39 00 00 00 00 00 06 B2 40 08 20 03 65	/* 03 AOR 89.0% 179*/
			39 00 00 00 00 00 06 B2 40 08 20 03 61	/* 04 AOR 88.6% 177*/
			39 00 00 00 00 00 06 B2 40 08 20 03 55	/* 05 AOR 87.4% 175*/
			39 00 00 00 00 00 06 B2 40 08 20 03 50	/* 06 AOR 86.9% 173*/
			39 00 00 00 00 00 06 B2 40 08 20 03 45	/* 07 AOR 85.8% 110*/
			39 00 00 00 00 00 06 B2 40 08 20 03 35	/* 08 AOR 84.1% 109*/
			39 00 00 00 00 00 06 B2 40 08 20 03 27	/* 09 AOR 82.7% 108*/
			39 00 00 00 00 00 06 B2 40 08 20 03 23	/* 10 AOR 82.3% */
			39 00 00 00 00 00 06 B2 40 08 20 03 17	/* 11 AOR 81.0% 108*/
			39 00 00 00 00 00 06 B2 40 08 20 03 11	/* 12 AOR 80.4% */
			39 00 00 00 00 00 06 B2 40 08 20 03 04	/* 13 AOR 79.1% */
			39 00 00 00 00 00 06 B2 40 08 20 02 F4	/* 14 AOR 77.5% */
			39 00 00 00 00 00 06 B2 40 08 20 02 E3	/* 15 AOR 75.7% */
			39 00 00 00 00 00 06 B2 40 08 20 02 D7	/* 16 AOR 74.5% */
			39 00 00 00 00 00 06 B2 40 08 20 02 C6	/* 17 AOR 72.7% */
			39 00 00 00 00 00 06 B2 40 08 20 02 B7	/* 18 AOR 71.2% */
			39 00 00 00 00 00 06 B2 40 08 20 02 A1	/* 19 AOR 69.0% */
			39 00 00 00 00 00 06 B2 40 08 20 02 91	/* 20 AOR 67.3% */
			39 00 00 00 00 00 06 B2 40 08 20 02 78	/* 21 AOR 64.8% */
			39 00 00 00 00 00 06 B2 40 08 20 02 62	/* 22 AOR 62.5% */
			39 00 00 00 00 00 06 B2 40 08 20 02 45	/* 23 AOR 59.5% */
			39 00 00 00 00 00 06 B2 40 08 20 02 30	/* 24 AOR 57.4% */
			39 00 00 00 00 00 06 B2 40 08 20 02 13	/* 25 AOR 54.4% */
			39 00 00 00 00 00 06 B2 40 08 20 01 F5	/* 26 AOR 51.3% */
			39 00 00 00 00 00 06 B2 40 08 20 01 D3	/* 27 AOR 47.8% */
			39 00 00 00 00 00 06 B2 40 08 20 01 B1	/* 28 AOR 44.4% */
			39 00 00 00 00 00 06 B2 40 08 20 01 87	/* 29 AOR 40.1% */
			39 00 00 00 00 00 06 B2 40 08 20 01 63	/* 30 AOR 36.6% */
			39 00 00 00 00 00 06 B2 40 08 20 01 35	/* 31 AOR 31.7% */
			39 00 00 00 00 00 06 B2 40 08 20 01 05	/* 32 AOR 26.9% */
			39 00 00 00 00 00 06 B2 40 08 20 00 D5	/* 33 AOR 21.8% */
			39 00 00 00 00 00 06 B2 40 08 20 00 A1	/* 34 AOR 16.5% */
			39 00 00 00 00 00 06 B2 40 08 20 00 6F	/* 35 AOR 11.4% */
			39 00 00 00 00 00 06 B2 40 08 20 00 31	/* 36 AOR 5.0% */
			39 00 00 00 00 00 06 B2 40 08 20 01 86	/* 37 AOR 40% */
			39 00 00 00 00 00 06 B2 40 08 20 00 08	/* 38 AOR 0.6% */
		];
		samsung,acl_on_tx_cmds = [
			39 01 00 00 00 00 02 55 02 
		];
		samsung,acl_off_tx_cmds = [
			39 01 00 00 72 00 02 55 00 
		];
		samsung,elvss_rx_cmds = [ 06 01 00 00 00 00 01 B6];
		samsung,elvss_temp_tx_cmds = [
			29 01 00 00 00 00 02 B0 07
			29 01 00 00 00 00 02 B8 00
			29 01 00 00 00 00 02 B0 15
			29 01 00 00 00 00 02 B6 00
		];
		samsung,elvss_tx_cmds = [
			39 00 00 00 00 00 03 B6 28 14		/* 0 105cd/m2 ~ 10cd/m2 */
			39 00 00 00 00 00 03 B6 28 14		/* 1 111cd/m2 */
			39 00 00 00 00 00 03 B6 28 13		/* 2 119cd/m2 */
			39 00 00 00 00 00 03 B6 28 12		/* 3 126cd/m2 */
			39 00 00 00 00 00 03 B6 28 12		/* 4 134cd/m2 */
			39 00 00 00 00 00 03 B6 28 11		/* 5 143cd/m2 */
			39 00 00 00 00 00 03 B6 28 10		/* 6 152cd/m2 */
			39 00 00 00 00 00 03 B6 28 0F		/* 7 162cd/m2 */
			39 00 00 00 00 00 03 B6 28 0E		/* 8 172cd/m2 */
			39 00 00 00 00 00 03 B6 28 11		/* 9 183cd/m2 */
			39 00 00 00 00 00 03 B6 28 11		/* 10 195cd/m2 */
			39 00 00 00 00 00 03 B6 28 10		/* 11 207cd/m2 */
			39 00 00 00 00 00 03 B6 28 0F		/* 12 220cd/m2 */
			39 00 00 00 00 00 03 B6 28 0F		/* 13 234cd/m2 */
			39 00 00 00 00 00 03 B6 28 0E		/* 14 249cd/m2 */
			39 00 00 00 00 00 03 B6 28 0D		/* 15 265cd/m2 */
			39 00 00 00 00 00 03 B6 28 0C		/* 16 282cd/m2 */
			39 00 00 00 00 00 03 B6 28 0B		/* 17 300cd/m2 */
		];
		samsung,mtp_rx_cmds =   [ 06 01 00 00 00 00 01 01];
		samsung,mdnie_rx_cmds = [ 06 01 00 00 00 00 01 B5];
	};
};
