## drivers/sensorhub/stm/Kconfig
```kconfig
#
# sensor drivers configuration
#

config SENSORS_SSP
	tristate "Sensors ssp"
	default n
	depends on SPI
	help
	  ssp driver for sensor hub.
          If you say yes here you get ssp support for
	  sensor hub.
	  To compile this driver as a module, choose M here: the
	  module will be called ssp.

config SENSORS_SSP_STM
	tristate "Sensors ssp stm"
	default n
	depends on SPI
	help
	  ssp driver for sensor hub.
          If you say yes here you get ssp support for
	  sensor hub.
	  To compile this driver as a module, choose M here: the
	  module will be called ssp.

config SENSORS_SSP_ACCELEROMETER_SENSOR
	tristate "Sensors ssp acceleromter sensor"
	default n
	depends on SPI
	help
          If you say yes here, accelererometer sensor supported
	  To compile this driver as a module, choose M here: the
	  module will be called ssp.

config SENSORS_SSP_GYRO_SENSOR
	tristate "Sensors ssp gyro sensor"
	default n
	depends on SPI
	help
          If you say yes here, gyro sensor supported
	  To compile this driver as a module, choose M here: the
	  module will be called ssp.

config SENSORS_SSP_MAGNETIC_SENSOR
	tristate "Sensors ssp magnetic sensor"
	default n
	depends on SPI
	help
          If you say yes here, magnetic sensor supported
	  To compile this driver as a module, choose M here: the
	  module will be called ssp.

config SENSORS_SSP_LIGHT_SENSOR
	tristate "Sensors ssp light sensor"
	default n
	depends on SPI
	help
          If you say yes here, light sensor supported
	  To compile this driver as a module, choose M here: the
	  module will be called ssp.

config SENSORS_SSP_PROXIMITY_SENSOR
	tristate "Sensors ssp proximity sensor"
	default n
	depends on SPI
	help
          If you say yes here, proximity sensor supported
	  To compile this driver as a module, choose M here: the
	  module will be called ssp.

config SENSORS_SSP_PRESSURE_SENSOR
	tristate "Sensors ssp pressure sensor"
	default n
	depends on SPI
	help
          If you say yes here, pressure sensor supported
	  To compile this driver as a module, choose M here: the
	  module will be called ssp.

config SENSORS_SSP_GESTURE_SENSOR
	tristate "Sensors ssp gesture sensor"
	default n
	depends on SPI
	help
          If you say yes here, gesture sensor supported
	  To compile this driver as a module, choose M here: the
	  module will be called ssp.

config SENSORS_SSP_TEMP_HUMID_SENSOR
	tristate "Sensors ssp temp_humid sensor"
	default n
	depends on SPI
	help
          If you say yes here, temp_humid sensor supported
	  To compile this driver as a module, choose M here: the
	  module will be called ssp.

config SENSORS_SSP_ROT_VECTOR_SENSOR
	tristate "Sensors ssp rotation vector sensor"
	default n
	depends on SPI
	help
          If you say yes here, rotation vector sensor supported
	  To compile this driver as a module, choose M here: the
	  module will be called ssp.

config SENSORS_SSP_HRM_SENSOR
	tristate "Sensors ssp hrm sensor"
	default n
	depends on SPI
	help
          If you say yes here, hrm sensor supported
	  To compile this driver as a module, choose M here: the
	  module will be called ssp.

config SENSORS_SSP_UV_SENSOR
	tristate "Sensors ssp uv sensor"
	default n
	depends on SPI
	help
          If you say yes here, uv sensor supported
	  To compile this driver as a module, choose M here: the
	  module will be called ssp.

config SENSORS_SSP_PIR_SENSOR
	tristate "Sensors ssp pir sensor"
	default n
	depends on SPI
	help
          If you say yes here, pir sensor supported
	  To compile this driver as a module, choose M here: the
	  module will be called ssp.

config SENSORS_SSP_META_DATA
	tristate "Sensors ssp meta data"
	default n
	depends on SPI
	help
          If you say yes here, meta data supported
	  To compile this driver as a module, choose M here: the
	  module will be called ssp.

config SENSORS_SSP_LPM_MOTION
	tristate "Sensors ssp lpm motion"
	default n
	depends on SPI
	help
          If you say yes here, lpm motion supported
	  To compile this driver as a module, choose M here: the
	  module will be called ssp.

source "drivers/sensorhub/stm/factory/Kconfig"
```

## drivers/sensorhub/stm/factory/Kconfig
```kconfig
#
# sensor drivers configuration
#

config SENSORS_SSP_ATUC128L5HAR
	tristate "Sensors ssp atuc128l5har"
	default n
	depends on SPI
	help
	  atuc128l5har file for factory test in ssp driver.
          If you say yes here you get atuc128l5har support for
	  factory test.
	  To compile this driver as a module, choose M here: the
	  module will be called ssp.

config SENSORS_SSP_STM32F401
	tristate "Sensors ssp stm32f401"
	default n
	depends on SPI
	help
	  stm32f401 file for factory test in ssp driver.
          If you say yes here you get stm32f401 support for
	  factory test.
	  To compile this driver as a module, choose M here: the
	  module will be called ssp.

config SENSORS_SSP_STM32F401CEY6B
	tristate "Sensors ssp stm32f401cey6b"
	default n
	depends on SPI
	help
	  stm32f401cey6b file for factory test in ssp driver.
          If you say yes here you get stm32f401cey6b support for
	  factory test.
	  To compile this driver as a module, choose M here: the
	  module will be called ssp.

config SENSORS_SSP_MPU6500
	tristate "Sensors ssp mpu6500"
	default n
	depends on SPI
	help
	  mpu6500 file for factory test in ssp driver.
          If you say yes here you get mpu6500 support for
	  factory test.
	  To compile this driver as a module, choose M here: the
	  module will be called ssp.

config SENSORS_SSP_MPU9250
	tristate "Sensors ssp mpu9250"
	default n
	depends on SPI
	help
	  mpu9250 file for factory test in ssp driver.
          If you say yes here you get mpu9250 support for
	  factory test.
	  To compile this driver as a module, choose M here: the
	  module will be called ssp.

config SENSORS_SSP_ICM20628
	tristate "Sensors ssp icm20628"
	default n
	depends on SPI
	help
	  icm20628 file for factory test in ssp driver.
          If you say yes here you get icm20628 support for
	  factory test.
	  To compile this driver as a module, choose M here: the
	  module will be called ssp.

config SENSORS_SSP_AK09911
	tristate "Sensors ssp ak09911"
	default n
	depends on SPI
	help
	  ak09911 file for factory test and doeplus in ssp driver.
          If you say yes here you get ak09911 support for
	  factory test.
	  To compile this driver as a module, choose M here: the
	  module will be called ssp.

config SENSORS_SSP_YAS532
	tristate "Sensors ssp yas532"
	default n
	depends on SPI
	help
	  yas532 file for factory test in ssp driver.
          If you say yes here you get yas532 support for
	  factory test.
	  To compile this driver as a module, choose M here: the
	  module will be called ssp.

config SENSORS_SSP_CM3320
	tristate "Sensors ssp cm3320"
	default n
	depends on SPI
	help
	  cm3320 file for factory test in ssp driver.
          If you say yes here you get cm3320 support for
	  factory test.
	  To compile this driver as a module, choose M here: the
	  module will be called ssp.

config SENSORS_SSP_MAX88920
	tristate "Sensors ssp max88920"
	default n
	depends on SPI
	help
	  max88920 file for factory test in ssp driver.
          If you say yes here you get max88920 support for
	  factory test.
	  To compile this driver as a module, choose M here: the
	  module will be called ssp.

config SENSORS_SSP_MAX88921
	tristate "Sensors ssp max88921"
	default n
	depends on SPI
	help
	  max88921 file for factory test in ssp driver.
          If you say yes here you get max88921 support for
	  factory test.
	  To compile this driver as a module, choose M here: the
	  module will be called ssp.

config SENSORS_SSP_TMG399X
	tristate "Sensors ssp tmg399x"
	default n
	depends on SPI
	help
	  max88005 file for factory test in ssp driver.
          If you say yes here you get al3320 support for
	  factory test.
	  To compile this driver as a module, choose M here: the
	  module will be called ssp.

config SENSORS_SSP_AL3320
	tristate "Sensors ssp al3320"
	default n
	depends on SPI
	help
	  al3320 file for factory test in ssp driver.
          If you say yes here you get al3320 support for
	  factory test.
	  To compile this driver as a module, choose M here: the
	  module will be called ssp.

config SENSORS_SSP_CM36686
	tristate "Sensors ssp cm36686"
	default n
	depends on SPI
	help
	  cm36686 file for factory test in ssp driver.
          If you say yes here you get cm36686 support for
	  factory test.
	  To compile this driver as a module, choose M here: the
	  module will be called ssp.

config SENSORS_SSP_LPS25H
	tristate "Sensors ssp lps25h"
	default n
	depends on SPI
	help
	  lps25h file for factory test in ssp driver.
          If you say yes here you get lps25h support for
	  factory test.
	  To compile this driver as a module, choose M here: the
	  module will be called ssp.

config SENSORS_SSP_SHTC1
	tristate "Sensors ssp shtc1"
	default n
	depends on SPI
	help
	  shtc1 file for factory test in ssp driver.
          If you say yes here you get shtc1 support for
	  factory test.
	  To compile this driver as a module, choose M here: the
	  module will be called ssp.

config SENSORS_SSP_ADPD142
	tristate "Sensors ssp adpd142"
	default n
	depends on SPI
	help
	  adpd142 file for factory test in ssp driver.
          If you say yes here you get adpd142 support for
	  factory test.
	  To compile this driver as a module, choose M here: the
	  module will be called ssp.

config SENSORS_SSP_UVIS25
	tristate "Sensors ssp UVIS25"
	default n
	depends on SPI
	help
	  uvis25 file for factory test in ssp driver.
          If you say yes here you get uvis25 support for
	  factory test.
	  To compile this driver as a module, choose M here: the
	  module will be called ssp.

config SENSORS_SSP_PYD1798
	tristate "Sensors ssp pyd1798"
	default n
	depends on SENSORS_SSP
	depends on SPI
	help
	  If you say yes here you get pyd1798 support for
	  factory test.
	  To compile this driver as a module, choose M here: the
	  module will be called ssp.
```

## drivers/sensors/Kconfig
```kconfig
#config SENSORS
#	bool "Sensors Class Support"
#	help
#	  This option enables the sensor sysfs class in /sys/class/sensors.
#	  You'll need this to do anything useful with sensorss. If unsure, say N.

config SENSORS_SSC
	bool "Enable Sensors Driver Support for SSC"
	help
	  Add support for sensors SSC driver.
	  This driver is used for exercising sensors use case,
	  time syncing with ADSP clock.

menuconfig SENSORS
	bool "Sensor devices"
	help
	  Say Y here, and a list of sensors drivers will be displayed.
	  Everything that didn't fit into the other categories is here. This option
	  doesn't affect the kernel.

	  If unsure, say Y.

config SENSORS_K2HH
	depends on I2C
	tristate "SENSORS_K2HH"
	default n
	help
	  Say Y here if you use SENSORS_K2HH.
	  This option enables accelerometer sensors using
	  STMicroelectronic K2HH device driver.

config SENSORS_K2HH_SW_I2C
	depends on I2C
	tristate "SENSORS_K2HH use SW I2C"
	default n
	help
	  Say Y here if you use SENSORS_K2HH SW I2C.

config SENSORS_BMA2X2
	tristate "BMA255/BMA250E/BMA222E/BMA280 acceleration sensor support"
	depends on I2C=y
	help
	  If you say yes here you get support for Bosch Sensortec's
	  acceleration sensors BMA255/BMA250E/BMA222E/BMA280.

config SENSORS_BMM050
	tristate "BMM050 Magnetic Sensor Driver"
	depends on I2C=y
	help
	 BMM050 Magnetic Sensor Driver implemented by Bosch-Sensortec.

config SENSORS_GP2A002
	tristate "GP2A002 proximity sensor support"
	depends on I2C
	default n
	help
	  If you say yes here you get support for sharp Sensortec's
	  proximity sensors GP2A002.

config SENSORS_IMS1911
	tristate "IMS1911 proximity sensor support"
	depends on I2C
	default n
	help
	  If you say yes here you get support for ITM Sensortec's
	  proximity sensors SENSORS_IMS1911.

config SENSORS_CM36672P
	tristate "CM36672P driver"
	depends on I2C
	default n
	help
	  If you say yes here you got support for Capella
	  CM36672P proximity driver.

config SENSORS_CM36672P_LEDA_EN_GPIO
	tristate "CM36672P leda_en controlled by GPIO"
	depends on I2C
	help
	  This option enables leda_en controlled by GPIO using CM36672P driver.

config WAKE_UP_MOTION
	bool "auto-motion wakeup"
	default n
	help
	  Say Y here if you want support for auto wakeup-mode of the K2HH sensor
	  device.

	  To compile this driver as a module, choose M here: the
	  module will be called K2HH.

source "drivers/sensors/mpu6500/Kconfig"
source "drivers/sensors/yas532/Kconfig"
```

## drivers/video/msm/mdss/Kconfig
```kconfig
config FB_MSM_MDSS_WRITEBACK
	bool "MDSS Writeback Panel"
	---help---
	The MDSS Writeback Panel provides support for routing the output of
	MDSS frame buffer driver and MDP processing to memory.

config FB_MSM_MDSS_HDMI_PANEL
	depends on FB_MSM_MDSS
	bool "MDSS HDMI Tx Panel"
	default n
	---help---
	The MDSS HDMI Panel provides support for transmitting TMDS signals of
	MDSS frame buffer data to connected hdmi compliant TVs, monitors etc.

config FB_MSM_MDSS_HDMI_MHL_SII8334
	depends on FB_MSM_MDSS_HDMI_PANEL
	bool 'MHL SII8334 support '
	default n
	---help---
	  Support the HDMI to MHL conversion.
	  MHL (Mobile High-Definition Link) technology
	  uses USB connector to output HDMI content

config FB_MSM_MDSS_DSI_CTRL_STATUS
	tristate "DSI controller status check feature"
	---help---
	  Check DSI controller status periodically (default period is 5
	  seconds) by sending Bus-Turn-Around (BTA) command. If DSI controller
	  fails to acknowledge the BTA command, it sends PANEL_ALIVE=0 status
	  to HAL layer to reset the controller.

config FB_MSM_MDSS_FAKE_RES
	depends on FB_MSM_MDSS
	bool "Support fake resolution"
	default n
	---help---
	  Support fake resolution, it can be supported various resolution by
	  sub xres, yres configuration.

config FB_MSM_MDSS_FAKE_XRES
	depends on FB_MSM_MDSS_FAKE_RES
	int "Support fake xres"
	default 1280
	---help---
	  Support fake xres information. but it only supports up to
	  1280 x 1920 resolution for video panel.

config FB_MSM_MDSS_FAKE_YRES
	depends on FB_MSM_MDSS_FAKE_RES
	int "Support fake yres"
	default 1920
	---help---
	  Support fake yres information. but it only supports up to
	  1280 x 1920 resolution for video panel.

config FB_MSM_MDSS_EDP_PANEL
	depends on FB_MSM_MDSS
	bool "MDSS eDP Panel"
	---help---
	The MDSS eDP Panel provides support for eDP host controller driver
	which runs in Video mode only and is responsible for transmitting
	frame buffer from host SOC to eDP display panel.

config FB_MSM_MDSS_MDP3
	depends on FB_MSM_MDSS
	bool "MDP3 display controller"
	---help---
	The MDP3 provides support for an older version display controller
	included in latest display sub-system, known as MDSS.

config FB_MSM_MDSS_OLED_PANEL
	depends on FB_MSM_MDSS
	bool "MDSS OLED panel dimming control"
	default n
	---help---
	MDSS Samsung OLED panel dimming feature support
	it can be support various OLED panel solution.

config FB_PANEL_S6E8AA5X01
	depends on FB_MSM_MDSS_OLED_PANEL
	bool "SDC S6E8AA5X01 LDI"
	default n
	---help---
	MDSS Samsung S6E8AA5X01 OLED Panel support
	it can be support S6E8AA5X01 smart dimming feature

config PANEL_S6E88A0_AMS427AP24_QHD
	depends on FB_MSM_MDSS_OLED_PANEL
	bool "LSI S6E88A0 LDI"
	default n
	---help---
	LSI S6E88A0 LDI 540_960 SERRANOVE

config MDSS_MDNIE_LITE_TUNING
	depends on FB_MSM_MDSS_OLED_PANEL
	bool "Support mdnie tuning"
	default n
	---help---
	MDSS Samsung panel mdnie support
	it can be support panel mdnie feature
```
